## components/serial/Kconfig
```kconfig
menu "serial frame"

    config LIBTINY_FRAME_SUPPORT
        bool "Support tiny frame"
        default y
        help
            tiny frame

endmenu
```

## components/xmodem/examples/xmodem_receiver/sdkconfig.defaults.esp8266
```kconfig
CONFIG_ESPTOOLPY_BAUD_921600B=y
CONFIG_PARTITION_TABLE_TWO_OTA=y
CONFIG_PARTITION_TABLE_CUSTOM_FILENAME="partitions.csv"
CONFIG_PARTITION_TABLE_OFFSET=0x8000
CONFIG_PARTITION_TABLE_FILENAME="partitions_two_ota.csv"
CONFIG_ESP_CONSOLE_UART_CUSTOM=y
CONFIG_ESP_CONSOLE_UART_CUSTOM_NUM_1=y
CONFIG_ESP_CONSOLE_UART_NUM=1
```

## components/xmodem/examples/xmodem_sender/sdkconfig.defaults.esp8266
```kconfig
CONFIG_ESPTOOLPY_BAUD_921600B=y
CONFIG_ESP_CONSOLE_UART_CUSTOM=y
CONFIG_ESP_CONSOLE_UART_CUSTOM_NUM_1=y
CONFIG_ESP_CONSOLE_UART_NUM=1
CONFIG_SUPPORT_FILE=y
```
